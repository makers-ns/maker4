/*

*/

unsigned int counter[6];
int seedPins[6] = {0,1,4,5,6,7};
int statePins[6] = {0,0,0,0,0,0};

unsigned long loopTime = 0;
unsigned long swapTime = 0;
unsigned long swapPeriod = 3; // delay between sending data

void setup() {
  
  Serial1.begin(9600);
  delay(1000);
  for (int i=0;i<6;i++){
    pinMode(seedPins[i],OUTPUT);
    statePins[i] = LOW;
    digitalWrite(seedPins[i],statePins[i]);
  }
  

}

void loop() {
  
  loopTime = millis();
  
  if((loopTime - swapTime) > swapPeriod){
    
    swapTime = loopTime;
    
    for (int i=0;i<6;i++){
      if (statePins[i] == LOW){
        statePins[i] = HIGH;
      } else {
        statePins[i] = LOW;        
      }
      ;
      digitalWrite(seedPins[i],statePins[i]);
    }
    
  }
}
